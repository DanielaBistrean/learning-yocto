## build/conf/bblayers.conf
```bitbake
BBPATH := "${TOPDIR}"

BBLAYERS = "\
    ${TOPDIR}/../poky/meta \
    ${TOPDIR}/../poky/meta-poky \
    ${TOPDIR}/../meta-openembedded/meta-oe \
    ${TOPDIR}/../meta-openembedded/meta-multimedia \
    ${TOPDIR}/../meta-openembedded/meta-networking \
    ${TOPDIR}/../meta-openembedded/meta-python \
    ${TOPDIR}/../meta-raspberrypi \
    ${TOPDIR}/../meta-flashing-rpi \
"
```

## meta-flashing-rpi/conf/layer.conf
```bitbake
BBPATH .= ":${LAYERDIR}"

BBFILES += "\
    ${LAYERDIR}/recipes-*/*/*.bb \
    ${LAYERDIR}/recipes-*/*/*.bbappend \
"

ENABLE_UART = "1"
```

## meta-learning-yocto/conf/layer.conf
```bitbake
# Make sure that all conf and bbclass files for this layer are reachable
BBPATH .= ":${LAYERDIR}"

# Add the path to the recipes
BBFILES += "${LAYERDIR}/recipes-*/*/*.bb"
```
